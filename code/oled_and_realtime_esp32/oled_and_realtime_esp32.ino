#include <NTPClient.h>
#include <WiFi.h>
#include <WiFiUdp.h>
#include <Wire.h>
#include <GOFi2cOLED.h>
#include <pgmspace.h>
#include <RtcDS3231.h>


// WiFi details
const char *ssid     = "Tenda_4CA1E0";
const char *password = "heodaugau";

// NTP
WiFiUDP ntpUDP;
NTPClient timeClient(ntpUDP, "2.asia.pool.ntp.org", 7*3600);
// RTC Libraries

RtcDS3231<TwoWire> Rtc(Wire);

// OLED
GOFi2cOLED GOFoled;

//32x32 pixeles
const unsigned char PROGMEM heart1[]={
0x00, 0x00, 0x00, 0x00, 0xC0, 0xE0, 0xE0, 0xF0, 0xF0, 0xF0, 0xF0, 0xF0, 0xF0, 0xE0, 0xC0, 0x80,
0x80, 0xC0, 0xE0, 0xF0, 0xF0, 0xF0, 0xF0, 0xF0, 0xF0, 0xF0, 0xE0, 0xC0, 0x80, 0x00, 0x00, 0x00,
0x00, 0x00, 0x00, 0x7F, 0xFF, 0xFF, 0xFF, 0xFF, 0xFF, 0xFF, 0xFF, 0xFF, 0xFF, 0xFF, 0xFF, 0xFF,
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0x0F, 0x07, 0x03, 0x03, 0x01, 0x00, 0x00, 0x00, 0x00, 0x00, 0x00, 0x00, 0x00, 0x00, 0x00, 0x00
};

//56x56 pixeles
const unsigned char PROGMEM heart2[]={
0x00, 0x00, 0x00, 0x00, 0x00, 0x00, 0x80, 0x80, 0xC0, 0xE0, 0xE0, 0xE0, 0xF0, 0xF0, 0xF0, 0xF0,
0xF0, 0xF0, 0xE0, 0xE0, 0xE0, 0xC0, 0x80, 0x80, 0x00, 0x00, 0x00, 0x00, 0x00, 0x00, 0x00, 0x00,
0x80, 0x80, 0xE0, 0xE0, 0xE0, 0xE0, 0xF0, 0xF0, 0xF0, 0xF0, 0xF0, 0xE0, 0xE0, 0xE0, 0xE0, 0xC0,
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0x00, 0x00, 0x00, 0x00, 0x00, 0x00, 0x00, 0x00, 
};



void WiFi_Setup(){

  Serial.print("Connecting to ");
  Serial.println(ssid);
  WiFi.begin(ssid, password);
  while (WiFi.status() != WL_CONNECTED) {
    delay(500);
    Serial.print(".");
  }
  Serial.println("");
  Serial.println("WiFi connected!");
}

// ************************************
// ** RTC Setup
// ************************************
void RTC_Update(){
  // Do udp NTP lookup, epoch time is unix time - subtract the 30 extra yrs (946684800UL) library expects 2000
  timeClient.update();
  unsigned long epochTime = timeClient.getEpochTime()-946684800UL;
  Rtc.SetDateTime(epochTime); 
}
bool RTC_Valid(){
  bool boolCheck = true; 
  if (!Rtc.IsDateTimeValid()){
    Serial.println("RTC lost confidence in the DateTime!  Updating DateTime");
    boolCheck = false;
    RTC_Update();    
  }
  if (!Rtc.GetIsRunning())
  {
    Serial.println("RTC was not actively running, starting now.  Updating Date Time");
    Rtc.SetIsRunning(true);
    boolCheck = false;
    RTC_Update();
  }
}



// Utility print function
#define countof(a) (sizeof(a) / sizeof(a[0]))
void printDateTime(const RtcDateTime& dt)
{
    char datestring[20];
    snprintf_P(datestring, 
            countof(datestring),
            PSTR("%02u/%02u/%04u %02u:%02u:%02u"),
            dt.Month(),
            dt.Day(),
            dt.Year(),
            dt.Hour(),
            dt.Minute(),
            dt.Second() );
    Serial.println(datestring);
}



void setup(){
  // Realtime 
  Serial.begin(115200);
  WiFi_Setup();
  // Start NTP Time Client
  timeClient.begin();
  delay(2000);
  timeClient.update();
  Rtc.Begin();
  RTC_Update();

  // OLED
  GOFoled.init(0x3C);
  GOFoled.display(); // show splashscreen
  delay(2000);
  GOFoled.clearDisplay();

  GOFoled.setTextSize(1);
  GOFoled.setTextColor(WHITE);
}


unsigned int day;
unsigned int month;;
unsigned int _year;
unsigned int second;
unsigned int minute;
unsigned int _hour;


void loop() {
  
  // Real time module
  if (!RTC_Valid()){
    RTC_Update();
  }
  RtcDateTime currTime = Rtc.GetDateTime();
  printDateTime(currTime);
  Serial.println(timeClient.getFormattedTime());
//  delay(10000);
  day    = currTime.Day();
  month  = currTime.Month();
  _year  = currTime.Year();
  second = currTime.Second();
  minute = currTime.Minute();
  _hour  = currTime.Hour();

  // OLED module
  GOFoled.clearDisplay();
  GOFoled.setCursor(10,56);
//  GOFoled.print("www.arduino.vn"); 
  GOFoled.print(month); GOFoled.print("/"); GOFoled.print(day); GOFoled.print("/"); GOFoled.print(_year); 
  GOFoled.print(" "); 
  GOFoled.print(_hour); GOFoled.print(":"); GOFoled.print(minute); GOFoled.print(":"); GOFoled.print(second);
//  GOFoled.print(timeClient.getFormattedTime());
  GOFoled.drawBitmap(48, 16, heart1, 32, 32, WHITE);  //draw heart1 bitmap.
  GOFoled.display();
  delay(500);  
  GOFoled.clearDisplay();
  
  GOFoled.setCursor(10, 56);
//  GOFoled.print("www.arduino.vn");  
  GOFoled.print(month); GOFoled.print("/"); GOFoled.print(day); GOFoled.print("/"); GOFoled.print(_year);
  GOFoled.print(" "); 
  GOFoled.print(_hour); GOFoled.print(":"); GOFoled.print(minute); GOFoled.print(":"); GOFoled.print(second); 
//  GOFoled.print(timeClient.getFormattedTime());
//  GOFoled.drawBitmap(36, 2, heart2, 56, 56, WHITE);  //draw heart2 bitmap.
  GOFoled.drawBitmap(48, 16, heart1, 32, 32, WHITE);  //draw heart1 bitmap.
  GOFoled.display();
  delay(400);  
  GOFoled.clearDisplay();  

}
